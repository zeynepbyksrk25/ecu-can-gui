ASAP2_VERSION 1 71
/begin PROJECT P ""
/begin MODULE M ""
/begin MOD_COMMON "" BYTE_ORDER MSB_LAST ALIGNMENT_BYTE 1 ALIGNMENT_WORD 2 ALIGNMENT_LONG 4 ALIGNMENT_FLOAT32_IEEE 4 /end MOD_COMMON
/begin COMPU_METHOD CM_RPM "" LINEAR "%6.1" "rpm" COEFFS_LINEAR 0.5 0 /end COMPU_METHOD
/begin COMPU_METHOD CM_RAT "" RAT_FUNC "%6.1" "degC" COEFFS 0 0.1 -40 0 0 1 /end COMPU_METHOD
/begin COMPU_METHOD CM_ID "" IDENTICAL "%6.1" "bar" /end COMPU_METHOD
/begin MEASUREMENT N_RPM "" UWORD CM_RPM 0 0 0 6000 ECU_ADDRESS 0x1000 /end MEASUREMENT
/begin MEASUREMENT Tt2_raw "" UWORD CM_RAT 0 0 0 120 ECU_ADDRESS 0x1010 /end MEASUREMENT
/begin MEASUREMENT FP_bar "" FLOAT32_IEEE CM_ID 0 0 0 10 ECU_ADDRESS 0x1020 /end MEASUREMENT
/begin MEASUREMENT clbc_Fuel_pump_dc_perc "" FLOAT32_IEEE CM_ID 0 0 0 100 ECU_ADDRESS 0x1030 /end MEASUREMENT
/begin MEASUREMENT clbc_Fuel_pump_dc_perc_sw "" UBYTE NO_COMPU_METHOD 0 0 0 1 ECU_ADDRESS 0x1040 /end MEASUREMENT
/begin MEASUREMENT NoAddr "" UBYTE NO_COMPU_METHOD 0 0 0 1 /end MEASUREMENT
/begin RECORD_LAYOUT RL_F32 FNC_VALUES 1 FLOAT32_IEEE COLUMN_DIR DIRECT /end RECORD_LAYOUT
/begin RECORD_LAYOUT RL_U16 FNC_VALUES 1 UWORD COLUMN_DIR DIRECT /end RECORD_LAYOUT
/begin CHARACTERISTIC clbc_Fuel_pump_gain "ayarlanabilir kazanc" VALUE 0x1100 RL_F32 0 CM_ID 0 100 /end CHARACTERISTIC
/begin CHARACTERISTIC clbc_Temp_limit "sicaklik siniri" VALUE 0x1110 RL_U16 0 CM_RPM 0 6000 /end CHARACTERISTIC
/end MODULE
/end PROJECT
