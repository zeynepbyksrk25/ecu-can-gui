ASAP2_VERSION 1 71
/begin PROJECT P "proj"
/begin MODULE M "mod"
/begin MOD_COMMON "common" BYTE_ORDER MSB_LAST ALIGNMENT_BYTE 1 /end MOD_COMMON
/begin COMPU_METHOD CM_LIN "lin" LINEAR "%6.2" "bar" COEFFS_LINEAR 0.5 10 /end COMPU_METHOD
/begin COMPU_METHOD CM_ID "id" IDENTICAL "%6.2" "-" /end COMPU_METHOD
/begin RECORD_LAYOUT RL_U16 FNC_VALUES 1 UWORD COLUMN_DIR DIRECT /end RECORD_LAYOUT
/begin RECORD_LAYOUT RL_U8 FNC_VALUES 1 UBYTE ROW_DIR DIRECT /end RECORD_LAYOUT
/begin MEASUREMENT MEAS_A "meas" UWORD CM_LIN 0 0 0 1000 ECU_ADDRESS 0x1000 /end MEASUREMENT
/begin CHARACTERISTIC PAR_A "par" VALUE 0x2000 RL_U16 0 CM_LIN 0 100 /end CHARACTERISTIC
/begin CHARACTERISTIC PAR_RO "ro" VALUE 0x2010 RL_U8 0 CM_ID 0 255 READ_ONLY /end CHARACTERISTIC
/begin CHARACTERISTIC BLK_A "blk" VAL_BLK 0x3000 RL_U16 0 CM_ID 0 60000 MATRIX_DIM 3 2 /end CHARACTERISTIC
/end MODULE
/end PROJECT
